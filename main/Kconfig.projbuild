## main/Kconfig.projbuild
```kconfig
menu "Wake-on-Radio Configuration"

    config WIFI_SSID
        string "WiFi SSID"
        default "myssid"
        help
            SSID of the AP to connect to after waking.

    config WIFI_PASSWORD
        string "WiFi Password"
        default "mypassword"
        help
            Password for the AP.

    choice WAKE_STRATEGY
        prompt "Wake strategy"
        default WAKE_STRATEGY_BASELINE
        help
            Select the radio wake strategy to compile.

        config WAKE_STRATEGY_BASELINE
            bool "Baseline (deep sleep + timer)"

        config WAKE_STRATEGY_LISTEN
            bool "Periodic listen windows"

        config WAKE_STRATEGY_ESPNOW
            bool "ESP-NOW broadcast wake"

        config WAKE_STRATEGY_BLE
            bool "BLE advertising wake"

        config WAKE_STRATEGY_DTIM
            bool "Wi-Fi DTIM-based power save"
    endchoice

    config LISTEN_INTERVAL_MS
        int "Listen window interval (ms)"
        default 1000
        depends on WAKE_STRATEGY_LISTEN || WAKE_STRATEGY_ESPNOW
        help
            How often to wake from light sleep and listen for a trigger.

    config LISTEN_DURATION_MS
        int "Listen window duration (ms)"
        default 50
        depends on WAKE_STRATEGY_LISTEN || WAKE_STRATEGY_ESPNOW
        help
            How long to keep the radio on each listen window.

    config LISTEN_MAGIC_SSID
        string "Magic SSID to detect in scan"
        default "WOR_TRIGGER"
        depends on WAKE_STRATEGY_LISTEN
        help
            The ESP32 scans for this SSID. When found, it wakes fully.

    config LISTEN_SCAN_CHANNEL
        int "Wi-Fi channel to scan (0 = all)"
        default 0
        depends on WAKE_STRATEGY_LISTEN
        help
            Fix to a single channel for faster scans. 0 scans all channels.

    config ESPNOW_CHANNEL
        int "ESP-NOW Wi-Fi channel"
        default 1
        depends on WAKE_STRATEGY_ESPNOW
        help
            Fixed channel for ESP-NOW communication.

    config ESPNOW_MAGIC
        hex "ESP-NOW magic trigger byte"
        default 0xA5
        depends on WAKE_STRATEGY_ESPNOW
        help
            First byte of ESP-NOW payload that triggers a full wake.

    config BLE_SCAN_WINDOW_MS
        int "BLE scan window (ms)"
        default 100
        depends on WAKE_STRATEGY_BLE
        help
            BLE scan window duration per cycle.

    config BLE_SCAN_INTERVAL_MS
        int "BLE scan interval (ms)"
        default 2000
        depends on WAKE_STRATEGY_BLE
        help
            Time between BLE scan cycles (includes sleep).

    config BLE_TRIGGER_NAME
        string "BLE trigger device name"
        default "WOR_TRIG"
        depends on WAKE_STRATEGY_BLE
        help
            BLE advertised name that triggers a full wake.

    config DTIM_LISTEN_INTERVAL
        int "DTIM listen interval multiplier"
        default 3
        depends on WAKE_STRATEGY_DTIM
        help
            Number of DTIM intervals between listens.
            Higher = more power savings, more latency.

    config DTIM_TRIGGER_PORT
        int "UDP trigger port"
        default 7777
        depends on WAKE_STRATEGY_DTIM
        help
            UDP port to listen on for wake triggers.

endmenu
```

## sdkconfig.defaults
```kconfig
# Target
CONFIG_IDF_TARGET="esp32s3"

# Serial flasher — 921600 baud for faster flashing
CONFIG_ESPTOOLPY_BAUD_921600B=y

# CPU — single core is enough and saves power
CONFIG_FREERTOS_UNICORE=y

# Power: disable unused peripherals at boot
CONFIG_ESP_PHY_CALIBRATION_AND_DATA_STORAGE=y

# Logging — keep INFO level for measurement, drop to WARN in production
CONFIG_LOG_DEFAULT_LEVEL_INFO=y

# Wi-Fi
CONFIG_ESP_WIFI_STATIC_RX_BUFFER_NUM=4
CONFIG_ESP_WIFI_DYNAMIC_RX_BUFFER_NUM=8
CONFIG_ESP_WIFI_DYNAMIC_TX_BUFFER_NUM=8

# IPv6
CONFIG_LWIP_IPV6=y

# Deep sleep: allow RTC memory retention for fast wake
CONFIG_ESP_SLEEP_RTC_BUS_ISO_WORKAROUND=y

# Console UART — 115200 for the RPi serial logger
CONFIG_ESP_CONSOLE_UART_BAUDRATE=115200

# Tickless idle — required for auto light sleep to actually engage
CONFIG_FREERTOS_USE_TICKLESS_IDLE=y

# PM profiling — tracks time spent in each power state
CONFIG_PM_PROFILING=y
```

## sdkconfig.defaults.ble
```kconfig
CONFIG_WAKE_STRATEGY_BLE=y
CONFIG_BT_ENABLED=y
CONFIG_BT_NIMBLE_ENABLED=y
CONFIG_BT_NIMBLE_ROLE_CENTRAL=y
CONFIG_BT_NIMBLE_ROLE_OBSERVER=y
CONFIG_BT_NIMBLE_ROLE_PERIPHERAL=n
CONFIG_BT_NIMBLE_ROLE_BROADCASTER=n
CONFIG_SW_COEXIST_ENABLE=y
CONFIG_PM_ENABLE=y
```

## sdkconfig.defaults.dtim
```kconfig
CONFIG_WAKE_STRATEGY_DTIM=y
CONFIG_PM_ENABLE=y
CONFIG_ESP_WIFI_SLP_IRAM_OPT=y
CONFIG_LWIP_SO_RCVBUF=y

# Reduce per-wake radio-on time (defaults are 50ms and 15ms)
CONFIG_ESP_WIFI_SLP_DEFAULT_MIN_ACTIVE_TIME=10
CONFIG_ESP_WIFI_SLP_DEFAULT_WAIT_BROADCAST_DATA_TIME=5
```
